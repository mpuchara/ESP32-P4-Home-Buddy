## components/identity/Kconfig
```kconfig
menu "Home Buddy local identity (experimental)"
config HB_IDENTITY_EXPERIMENTAL
    bool "Enable local onboard Flash MBF recognition worker"
    default n
    help
        Explicit development opt-in. Requires the provisioned human_face_feat
        onboard Flash partition. Never downloads models during operation.
config HB_IDENTITY_PERSISTENCE
    bool "Enable local profile persistence"
    default n
    help
        Uses the existing profiles partition. Never provisions device security.
config HB_IDENTITY_LOCAL_UNENCRYPTED
    bool "Explicit local unencrypted household storage policy"
    depends on HB_IDENTITY_PERSISTENCE
    default n
    help
        Owner selected automatic local storage without encryption or unlock.
        With this off, persistence requires hardware encryption and Secure Boot.
config HB_IDENTITY_THRESHOLD_MILLI
    int "Experimental cosine acceptance threshold (thousandths)"
    range 0 1000
    default 700
config HB_IDENTITY_MARGIN_MILLI
    int "Experimental different-person margin (thousandths)"
    range 1 1000
    default 120
config HB_IDENTITY_AGREEMENT_MILLI
    int "Experimental template agreement floor (thousandths)"
    range 0 1000
    default 600
endmenu
```

## sdkconfig.defaults
```kconfig
CONFIG_IDF_TARGET="esp32p4"
CONFIG_ESPTOOLPY_FLASHSIZE_16MB=y
CONFIG_ESPTOOLPY_FLASHMODE_DIO=y
CONFIG_PARTITION_TABLE_CUSTOM=y
CONFIG_PARTITION_TABLE_CUSTOM_FILENAME="partitions.csv"
CONFIG_SPIRAM=y
CONFIG_SPIRAM_SPEED_80M=y
CONFIG_SPIRAM_USE_MALLOC=y
CONFIG_SPIRAM_MEMTEST=y
CONFIG_ESP32P4_REV_MIN_1=y
CONFIG_ESP_MAIN_TASK_STACK_SIZE=8192
CONFIG_FREERTOS_HZ=1000
CONFIG_ESP_CONSOLE_USB_SERIAL_JTAG=y
CONFIG_LV_COLOR_DEPTH_16=y
CONFIG_LV_FONT_MONTSERRAT_24=y
CONFIG_LV_FONT_MONTSERRAT_48=y
CONFIG_LV_MEM_SIZE_KILOBYTES=128
CONFIG_LV_BUILD_EXAMPLES=n
CONFIG_ESP_HOSTED_SDIO_HOST_INTERFACE=y
CONFIG_ESP_HOSTED_ENABLED=n
CONFIG_ESP_HOSTED_SDIO_SLOT_1=y
CONFIG_ESP_HOSTED_PRIV_SDIO_PIN_CLK_SLOT_1=18
CONFIG_ESP_HOSTED_PRIV_SDIO_PIN_CMD_SLOT_1=19
CONFIG_ESP_HOSTED_PRIV_SDIO_PIN_D0_SLOT_1=14
CONFIG_ESP_HOSTED_PRIV_SDIO_PIN_D1_4BIT_BUS_SLOT_1=15
CONFIG_ESP_HOSTED_PRIV_SDIO_PIN_D2_4BIT_BUS_SLOT_1=16
CONFIG_ESP_HOSTED_PRIV_SDIO_PIN_D3_4BIT_BUS_SLOT_1=17
CONFIG_ESP_HOSTED_SDIO_GPIO_RESET_SLAVE=54

CONFIG_FLASH_HUMAN_FACE_DETECT_MSRMNP_S8_V1=n
CONFIG_FLASH_ESPDET_PICO_224_224_FACE=n
CONFIG_FLASH_ESPDET_PICO_416_416_FACE=y
CONFIG_ESPDET_PICO_416_416_FACE=y
CONFIG_HUMAN_FACE_DETECT_MODEL_IN_FLASH_RODATA=y
CONFIG_HUMAN_FACE_FEAT_MODEL_IN_FLASH_RODATA=y
CONFIG_HUMAN_FACE_FEAT_MBF_S8_V1=y
CONFIG_FLASH_HUMAN_FACE_FEAT_MFN_S8_V1=n
CONFIG_FLASH_HUMAN_FACE_FEAT_MBF_S8_V1=y
CONFIG_MBEDTLS_CERTIFICATE_BUNDLE=y

CONFIG_PARTITION_TABLE_OFFSET=0x10000
CONFIG_BOOTLOADER_APP_ROLLBACK_ENABLE=n
# Keep MIPI DSI frame DMA restarting during profile Flash erase/program.
CONFIG_LCD_DSI_ISR_IRAM_SAFE=y
CONFIG_CAM_CTLR_MIPI_CSI_ISR_CACHE_SAFE=y
```
